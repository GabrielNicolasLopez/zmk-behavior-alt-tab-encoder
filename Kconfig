## Kconfig
```kconfig
DT_COMPAT_ZMK_BEHAVIOR_ALT_TAB_ENCODER := zmk,behavior-alt-tab-encoder

config ZMK_BEHAVIOR_ALT_TAB_ENCODER
        bool
        default $(dt_compat_enabled,$(DT_COMPAT_ZMK_BEHAVIOR_ALT_TAB_ENCODER))
```

## dts/bindings/behaviors/zmk,behavior-alt-tab-encoder.yaml
```yaml
# Copyright (c) 2026
# SPDX-License-Identifier: MIT

description: Alt-Tab encoder behavior with a shared inactivity timeout

compatible: "zmk,behavior-alt-tab-encoder"

properties:
  label:
    type: string
    required: false
    deprecated: true

  "#sensor-binding-cells":
    type: int
    required: true
    const: 0

  bindings:
    type: phandle-array
    required: true
    description: >
      Three bindings in this order:
      1) hold binding (usually &kp LALT)
      2) clockwise binding (usually &kp TAB)
      3) counter-clockwise binding (usually &kp LS(TAB))

  tap-ms:
    type: int
    default: 5

  release-after-ms:
    type: int
    default: 1000
```
